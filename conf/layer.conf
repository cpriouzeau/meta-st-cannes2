## conf/layer.conf
```bitbake
# We have a conf and classes directory, add to BBPATH
BBPATH .= ":${LAYERDIR}"

# We have a recipes-* directories, add to BBFILES
BBFILES += "${LAYERDIR}/recipes-*/*/*.bb \
	${LAYERDIR}/recipes-*/*/*.bbappend"

BBFILE_COLLECTIONS += "st-cannes2"
BBFILE_PATTERN_st-cannes2 := "^${LAYERDIR}/"
BBFILE_PRIORITY_st-cannes2 = "9"

#--------------------------
# Defines how BitBake handles situations where an append file (.bbappend) has no corresponding recipe file (.bb).
#
BB_DANGLINGAPPENDS_WARNONLY = "1"

#--------------------------
# Eula
EULA_FILE_ST = "${LAYERDIR}/conf/eula/${MACHINE}"

# This should only be incremented on significant changes that will
# cause compatibility issues with other layers
LAYERVERSION_st-cannes2 = "1"
LAYERSERIES_COMPAT_st-cannes2 = "sumo"
```

## conf/machine/include/gpu_mali.inc
```bitbake
# =========================================================================
# GPU
# =========================================================================
GPU_USERLAND_LIBRARIES_WAYLAND ?= "mali400-userland-multi-binary"

# Helper function for overloading the default EGL/GLES implementation.
# The Mali libraries provided by ARM are compatible with the Mesa headers
# but we can have several backend available following the distro configuration:
#  - wayland
#  - x11
#  - wayland + x11
#  - framebuffer
#  - drm

def get_gpu_mali_handler(d):
    """  Overloading the default EGL/GLES/mesa implementation."""
    machine_features = d.getVar('MACHINE_FEATURES', True).split()
    distro_features = d.getVar('DISTRO_FEATURES', True).split()

    gpu_lib_wayland = d.getVar('GPU_USERLAND_LIBRARIES_WAYLAND', True).split()

    if 'gpu' in machine_features:
        if 'wayland' in distro_features:
            provider = gpu_lib_wayland[0]
        else:
            if 'x11' in distro_features:
                provider = "mesa"
            else:
                '''no wayland, no X11 -> choose DRM for eglfs'''
                provider = gpu_lib_wayland[0]
    else:
        provider = "mesa"

    return provider;

GPU_USERLAND_LIBRARIES_INSTALL = "${@get_gpu_mali_handler(d)}"

PREFERRED_PROVIDER_virtual/egl_stih410-b2260 = "${@get_gpu_mali_handler(d)}"
PREFERRED_PROVIDER_virtual/libgles1_stih410-b2260 = "${@get_gpu_mali_handler(d)}"
PREFERRED_PROVIDER_virtual/libgles2_stih410-b2260 = "${@get_gpu_mali_handler(d)}"
PREFERRED_PROVIDER_virtual/mesa_stih410-b2260 = "${@bb.utils.contains('PREFERRED_PROVIDER_virtual/egl','${GPU_USERLAND_LIBRARIES_WAYLAND}','mesa-gl','mesa',d)}"
PREFERRED_PROVIDER_virtual/libgl_stih410-b2260 = "${@bb.utils.contains('PREFERRED_PROVIDER_virtual/egl','${GPU_USERLAND_LIBRARIES_WAYLAND}','mesa-gl','mesa',d)}"
```

## conf/machine/sti-96bc2.conf
```bitbake
#@TYPE: Machine
#@NAME: sti-96c2
#@DESCRIPTION: Machine configuration for ST Cannes2  systems to build with Linux-STI Kernel 4.6 support


# =========================================================================
# Chip architecture
# =========================================================================
DEFAULTTUNE = "cortexa9thf-neon"
include conf/machine/include/tune-cortexa9.inc

# =========================================================================
# Machine settings
# =========================================================================
# Default machine feature
MACHINE_FEATURES = "usbhost"
MACHINE_FEATURES =+ "bluetooth"
MACHINE_FEATURES =+ "wifi"

# Default serial consoles (TTYs) to enable using getty
SERIAL_CONSOLES = "115200;ttyAS1"

# Ship all kernel by default
MACHINE_EXTRA_RRECOMMENDS = " \
    kernel                    \
    kernel-base               \
    kernel-image              \
    kernel-modules            \
    "
# =========================================================================
# Xserver
# =========================================================================
XSERVER ?= " \
    xserver-xorg \
    xserver-xorg-module-libint10 \
    xf86-video-modesetting \
    xf86-input-evdev \
    xf86-input-mouse \
    xf86-input-keyboard \
"

# =========================================================================
# Image
# =========================================================================
IMAGE_FSTYPES_append = " ext4"

# =========================================================================
# Package configuration
# =========================================================================
# Force the lgpl functionnality usage for libav
PACKAGECONFIG_pn-gstreamer1.0-libav = " lgpl "

# =========================================================================
# Kernel
# =========================================================================
# Select default kernel version
# NOTE: this setting should be done in machine.conf file itself
LINUXLIBCVERSION                  = "4.6"
PREFERRED_PROVIDER_virtual/kernel = "linux-sti"
PREFERRED_VERSION_linux-sti       = "4.6"

# Kernel image type
KERNEL_IMAGETYPE     =  "uImage"
KERNEL_ALT_IMAGETYPE =  " Image "
KERNEL_ALT_IMAGETYPE =+ " vmlinux "

# Kernel loadaddr
STM_KERNEL_LOADADDR  = "0x40008000"

# List of device tree to install
KERNEL_DEVICETREE =  ""
KERNEL_DEVICETREE =+ " stih407-b2120.dtb "
KERNEL_DEVICETREE =+ " stih410-b2120.dtb "
KERNEL_DEVICETREE =+ " stih410-b2260.dtb "

# =========================================================================
# Kernel COMMAND LINE
# key work:
#   ##ROOT##: key work will should be replaced by device name like /dev/sda1
#   ##MEMORY##: key work will should be replaced by content of KERNEL_CMDLINE_MEMORY
# =========================================================================
KERNEL_CMDLINE_MEMORY = "mem=1024M@0x40000000"
KERNEL_CMDLINE = "console=ttyAS1,115200 CONSOLE=/dev/ttyAS1 consoleblank=0 root=##ROOT## rootfstype=ext4 rw rootwait ${KERNEL_CMDLINE_MEMORY} vmalloc=256m video=HDMI-A-1:1920x1080 "
KERNEL_CMDLINE_DEV_APPEND = "clk_ignore_unused"


# =========================================================================
# Provider
# =========================================================================
# for openvt tools
PREFERRED_PROVIDER_console-tools ?= "kbd"
# =========================================================================
# Version
# =========================================================================
#PREFERRED_VERSION_libdrm = "2.4.67"

# =========================================================================
# bluetooth addons
# =========================================================================
IMAGE_INSTALL_append = " ${@bb.utils.contains('MACHINE_FEATURES', 'bluetooth', 'linux-firmware-rtl8723bu', '', d)} "
IMAGE_INSTALL_append = " ${@bb.utils.contains('MACHINE_FEATURES', 'bluetooth', 'rtl8723bu', '', d)} "
```

## conf/machine/stih410-b2260.conf
```bitbake
#@TYPE: Machine
#@NAME: stih410-b2260
#@DESCRIPTION: Machine configuration for ST Cannes2  systems to build with Linux-STI Kernel 4.6 support

# =========================================================================
# Chip architecture
# =========================================================================
require conf/machine/include/tune-cortexa9.inc
include conf/machine/include/gpu_mali.inc

# =========================================================================
# Machine settings
# =========================================================================
# Default machine feature
MACHINE_FEATURES = "usbhost usbgadget alsa screen bluetooth wifi ext2"

# Default serial consoles (TTYs) to enable using getty
SERIAL_CONSOLES = "115200;ttyAS1"

# Ship all kernel by default
MACHINE_EXTRA_RRECOMMENDS = " \
    kernel-modules            \
    ${@bb.utils.contains('DISTRO_FEATURES', 'bluetooth', 'rtl8723bu-stih410-b2260', '', d)} \
    ${@bb.utils.contains('DISTRO_FEATURES', 'bluetooth', 'linux-firmware-rtl8723bu', '', d)} \
    ${@bb.utils.contains('MACHINE_FEATURES', 'gpu', 'mali400-driver-stih410-b2260 ', '', d)} \
    ${@bb.utils.contains('MACHINE_FEATURES', 'gpu', '${GPU_USERLAND_LIBRARIES_INSTALL}', '', d)} \
    linux-sti-firmware-fdma \
    "

# =========================================================================
# Xserver
# =========================================================================
XSERVER ?= " \
    xserver-xorg \
    xserver-xorg-module-libint10 \
    xf86-input-evdev \
    xf86-video-modesetting \
"

# =========================================================================
# Image
# =========================================================================
# BSP default settings
IMAGE_CLASSES += "image_types-st"
IMAGE_FSTYPES_append = " ext4.gz stimg "

# =========================================================================
# Kernel
# =========================================================================
PREFERRED_PROVIDER_virtual/kernel = "linux-sti"
PREFERRED_VERSION_linux-sti       = "4.19"

SERIAL_CONSOLE = "115200 ttyAS1"

# Kernel image type
KERNEL_IMAGETYPE     =  "uImage"
KERNEL_ALT_IMAGETYPE = " vmlinux "

# Kernel loadaddr
ST_KERNEL_LOADADDR  = "0x40008000"

# List of device tree to install
KERNEL_DEVICETREE = " stih410-b2260.dtb "

# =========================================================================
# Kernel COMMAND LINE
# key work:
#   ##ROOT##: key work will should be replaced by device name like /dev/sda1
#   ##MEMORY##: key work will should be replaced by content of KERNEL_CMDLINE_MEMORY
# =========================================================================
KERNEL_CMDLINE_MEMORY = "mem=1024M@0x40000000"
KERNEL_CMDLINE = "console=ttyAS1,115200 CONSOLE=/dev/ttyAS1 consoleblank=0 root=##ROOT## rootfstype=ext4 rw rootwait ${KERNEL_CMDLINE_MEMORY} vmalloc=256m  "
KERNEL_CMDLINE_DEV_APPEND = "clk_ignore_unused"

# =========================================================================
# U boot
PREFERRED_PROVIDER_virtual/bootloader = "u-boot-sti"
# Configuration
UBOOT_CONFIG = "b2260"
EXTRA_IMAGEDEPENDS += "u-boot-sti"

# =========================================================================
# GPU
# =========================================================================
# Issue with libmali No gpu alvailable
GPU_USERLAND_LIBRARIES_WAYLAND = "mesa"
# if GPU (mali400) are activated and EULA is accepted
#MACHINE_FEATURES =+ "${@'gpu' if d.getVar('ACCEPT_EULA_'+d.getVar('MACHINE', True), True) == '1' else ''}"
```
